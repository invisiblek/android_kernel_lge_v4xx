## arch/arm/mach-msm/lge/Kconfig
```kconfig
config MACH_LGE
	bool

menu "LGE Board Selection"

config MACH_MSM8226_E7WIFI
        depends on ARCH_MSM8226
        select MACH_LGE
        bool "APQ8026 E7WIFI OPEN"
        help
          Support for the Qualcomm APQ8026 E7 WiFi-Only device.

config MACH_MSM8926_E7LTE_ATT_US
        depends on ARCH_MSM8226
        select MACH_LGE
        bool "MSM8926 E7LTE ATT US"
        help
          Support for the Qualcomm MSM8926 E7 LTE device.

config MACH_MSM8226_E8WIFI
        depends on ARCH_MSM8226
        select MACH_LGE
        bool "APQ8026 E8WIFI OPEN"
        help
          Support for the Qualcomm APQ8026 E8 WiFi-Only device.

endmenu

menu "LGE Specific Patches"

config LGE_BOOTLOADER_LOG
	tristate "Support LGE bootloader log"
	default n
	depends on MACH_LGE
	help
	  LGE bootloader log

config DTS_TARGET
	string "DTS target dir"
	help
	  CONFIG_DTS_TARGET should be set to support appended dts.

config LGE_BOOTLOADER_TIME_CHECKER
	bool "Show bootloader(LK, SBL) time"
	default n
	depends on MACH_LGE
	help
	  This shows the lk and sbl1 booting time in MSM8974.
	  If this feature is enabled, it should be check by adb shell.
	  Device Node : sys/module/lge_bootloader_time_checker/

config LGE_QFPROM_INTERFACE
	bool "Support qfprom interface"
	default n
	depends on MACH_LGE
	help
	  LGE QFPROM DRIVER.

menu "LGE Battery Profile"

config LGE_PM_BATTERY_CAPACITY_4000mAh
        bool "Support Battery Capacity : 4000mAh"
        depends on LGE_PM_BATTERY_PROFILE_DATA
        help
          LGE battery capacity for 4000mAh

config LGE_PM_BATTERY_CAPACITY_4200mAh
        bool "Support Battery Capacity : 4200mAh"
        depends on LGE_PM_BATTERY_PROFILE_DATA
        help
          LGE battery capacity for 4200mAh

endmenu

endmenu
```

## drivers/input/sensor/Kconfig
```kconfig
# LGE_CHANGE_S: define kconfig for sensors
#
# Sensor driver configuration
#
menuconfig INPUT_SENSOR
	bool "Sensors"
	help
	  Say Y here, and a list of supported touchscreens will be displayed.
	  This option doesn't affect the kernel.

	  If unsure, say Y.

if INPUT_SENSOR

config SENSOR_SX9500
    tristate "SX9500 based capacitive touch button"
    depends on I2C
    help
      Say Y here if you have a SX9500.
      If unsure, say N.

      To compile this driver as a module, choose M here: the
      module will be called sx8651.

endif
# LGE_CHANGE_E
```
